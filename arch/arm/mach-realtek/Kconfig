## arch/arm/mach-realtek/Kconfig
```kconfig
if ARCH_REALTEK

config TARGET_RTD1619
	bool "Realtek RTD1619 chainloaded U-Boot"
	select ARM64
	select DM
	select OF_CONTROL
	help
	  Minimal RTD1619 support intended to be chainloaded by the vendor
	  bootloader after DRAM and EL3 firmware are already initialized.

config SYS_CPU
	default "armv8"

config SYS_VENDOR
	default "realtek"

config SYS_BOARD
	default "rtd1619"

config SYS_SOC
	default "realtek"

config SYS_CONFIG_NAME
	default "rtd1619"

config DEFAULT_DEVICE_TREE
	default "realtek/rtd1619-x1-prime-c"

endif
```

## board/realtek/rtd1619/Kconfig
```kconfig
if TARGET_RTD1619

config SYS_BOARD
	default "rtd1619"

config SYS_VENDOR
	default "realtek"

config SYS_CONFIG_NAME
	default "rtd1619"

endif
```

## configs/rtd1619_defconfig
```kconfig
CONFIG_ARM=y
CONFIG_ARM64=y
CONFIG_SKIP_LOWLEVEL_INIT=y
CONFIG_ARCH_REALTEK=y
CONFIG_TARGET_RTD1619=y
CONFIG_POSITION_INDEPENDENT=y
CONFIG_COUNTER_FREQUENCY=27000000
CONFIG_TEXT_BASE=0x05000000
CONFIG_SYS_MALLOC_LEN=0x800000
CONFIG_SYS_MALLOC_F_LEN=0x4000
CONFIG_NR_DRAM_BANKS=1
CONFIG_ENV_SIZE=0x4000
CONFIG_DEFAULT_DEVICE_TREE="realtek/rtd1619-x1-prime-c"
CONFIG_OF_UPSTREAM=y
CONFIG_SYS_LOAD_ADDR=0x08000000
CONFIG_BOOTDELAY=3
CONFIG_HUSH_PARSER=y
CONFIG_SYS_PROMPT="RTD1619> "
CONFIG_SYS_MAXARGS=32
CONFIG_CMD_BOOTI=y
CONFIG_CMD_FDT=y
CONFIG_CMD_MEMINFO=y
CONFIG_CMD_CACHE=y
CONFIG_CMD_PART=y
CONFIG_CMD_GPT=y
CONFIG_CMD_MBR=y
CONFIG_CMD_FAT=y
CONFIG_CMD_EXT4=y
CONFIG_CMD_FS_GENERIC=y
CONFIG_CMD_USB=y
CONFIG_CMD_TIME=y
CONFIG_OF_CONTROL=y
CONFIG_OF_LIBFDT=y
CONFIG_DM=y
CONFIG_DM_SERIAL=y
CONFIG_SYS_NS16550=y
CONFIG_SYS_NS16550_MEM32=y
CONFIG_SYS_NS16550_CLK=27000000
CONFIG_SYS_NS16550_REG_SIZE=-4
CONFIG_SERIAL_SEARCH_ALL=y
CONFIG_USB=y
CONFIG_DM_USB=y
CONFIG_USB_XHCI_HCD=y
CONFIG_USB_XHCI_DWC3=y
CONFIG_USB_STORAGE=y
CONFIG_BLK=y
CONFIG_PARTITIONS=y
CONFIG_DOS_PARTITION=y
CONFIG_EFI_PARTITION=y
# CONFIG_NET is not set
# CONFIG_EFI_LOADER is not set
```
